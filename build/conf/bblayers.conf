## build/conf/bblayers.conf
```bitbake
BBLAYERS ?= " \
  /home/py/yocto/bitbake-builds/yocto-woowee/layers/openembedded-core/meta \
  /home/py/yocto/bitbake-builds/yocto-woowee/layers/meta-yocto/meta-yocto-bsp \
  /home/py/yocto/bitbake-builds/yocto-woowee/layers/meta-yocto/meta-poky \
  /home/py/yocto/bitbake-builds/yocto-woowee/layers/meta-woowee \
  /home/py/yocto/bitbake-builds/yocto-woowee/layers/meta-raspberrypi \
  /home/py/yocto/bitbake-builds/yocto-woowee/layers/meta-openembedded/meta-oe \
  /home/py/yocto/bitbake-builds/yocto-woowee/layers/meta-openembedded/meta-python \
  /home/py/yocto/bitbake-builds/yocto-woowee/layers/meta-ros/meta-ros-common \
  /home/py/yocto/bitbake-builds/yocto-woowee/layers/meta-ros/meta-ros2 \
  /home/py/yocto/bitbake-builds/yocto-woowee/layers/meta-ros/meta-ros2-lyrical \
  /home/py/yocto/bitbake-builds/yocto-woowee/layers/meta-zenoh/meta-zenoh \
  "
```
